## drivers/misc/mrvl-bmm/Kconfig
```kconfig
config DOVE_MRVL_BMM
	tristate "Marvell Buffer management module"
	default y
	help
	  This driver needs to co-work with user space BMM library.
	  The user space driver can use this driver/library to maintain it's own buffer.

config DOVE_VPU_GPU_USE_BMM
	bool "Dove VPU & GPU use BMM"
	depends on DOVE_MRVL_BMM
	default y
	help
	  Dove VPU & GPU use BMM to maintian buffer.
```

## sound/soc/orion/Kconfig
```kconfig
menu "SoC Audio for the Marvell SoC's"

config SND_DOVE_AC97
	tristate "Marvell Dove AC97 interface support"
	depends on ARCH_DOVE && SND_SOC
	select SND_AC97_CODEC
	select AC97_BUS
	help
	  Say Y or M if you want to add support for the AC97 interface in Marvell
	  SoC's.

config SND_DOVE_SOC_DB
	tristate "SoC AC97 Audio support for Marvell Dove DB"
	depends on SND_DOVE_AC97 && (MACH_DOVE_DB || MACH_DOVE_DB_Z0)
	select SND_PXA2XX_SOC
	select SND_PXA2XX_LIB
	select SND_PXA2XX_SOC_AC97
	select SND_PXA2XX_SOC_AC97_SURROUND
	select SND_SOC_AD1980
	help
	  Say Y if you want to add support for SoC audio on Marvell
	  Dove Development Board.


config SND_DOVE_SOC_MRVL_AUDIO
	tristate "Marvell mv88fx Audio ALSA SOC driver"
	depends on MV_INCLUDE_AUDIO && SND_SOC
	select SND_SOC_CS42L51
	help
	  Say Y if you want to add support for SoC audio on Marvell
	  Dove Development Board.



endmenu
```

## ubuntu/wireless/wimax-i2400m/drivers/Kconfig
```kconfig
# @lket@ignore-file

# @lket@add-start drivers/Kconfig source "drivers/usb/Kconfig"

source "drivers/uwb/Kconfig"
# @lket@add-end
```
